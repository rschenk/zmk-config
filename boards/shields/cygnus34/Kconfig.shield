## boards/shields/cygnus34/Kconfig.shield
```kconfig
# Copyright (c) 2020 Pete Johanson
# SPDX-License-Identifier: MIT

config SHIELD_CYGNUS34_LEFT
    def_bool $(shields_list_contains,cygnus34_left)

config SHIELD_CYGNUS34_RIGHT
    def_bool $(shields_list_contains,cygnus34_right)
```

## config/west.yml
```yaml
manifest:
  remotes:
    - name: zmkfirmware
      url-base: https://github.com/zmkfirmware
    - name: caksoylar
      url-base: https://github.com/caksoylar
    - name: dhruvinsh
      url-base: https://github.com/dhruvinsh
    - name: rschenk
      url-base: https://github.com/rschenk
    - name: urob
      url-base: https://github.com/urob
  projects:
    - name: zmk
      remote: zmkfirmware
      revision: v0.3
      import: app/west.yml
    - name: zmk-rgbled-widget
      remote: caksoylar
      revision: main
    - name: zmk-tri-state
      remote: dhruvinsh
      revision: main
    - name: zmk-auto-layer
      remote: urob
      revision: v0.3
    - name: zmk-adaptive-key
      remote: urob
      revision: v0.3
    - name: zmk-keyboard-re-gret
      remote: rschenk
      revision: v0.3
    - name: zmk-component-raytac-dongle
      remote: rschenk
      revision: v0.3
  self:
    path: config
```
